## src/modules/aaservo/Kconfig
```kconfig
menuconfig MODULES_AASERVO
	bool "aaservo"
	default n
	---help---
		Enable support for aaservo
```

## src/modules/aatest/Kconfig
```kconfig
menuconfig MODULES_AATEST
	bool "aatest"
	default n
	---help---
		Enable support for aatest
```
